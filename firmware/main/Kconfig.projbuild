## firmware/main/Kconfig.projbuild
```kconfig
menu "RS-1 Configuration"

    choice RS1_VARIANT
        prompt "RS-1 Product Variant"
        default RS1_VARIANT_PRO
        help
            Select the RS-1 product variant to build firmware for.

        config RS1_VARIANT_PRO
            bool "RS-1 Pro (LD2410 + LD2450 dual radar)"
            help
                Build for RS-1 Pro with dual-radar fusion.
                Features: Zone tracking, multi-target detection.

        config RS1_VARIANT_LITE
            bool "RS-1 Lite (LD2410 only)"
            help
                Build for RS-1 Lite with single radar.
                Features: Binary presence detection only.
    endchoice

    config RS1_DEVICE_NAME
        string "Device Name"
        default "RS-1 Presence Sensor"
        help
            Default device name for mDNS and Native API discovery.

    menu "Radar Configuration"

        config RS1_LD2410_RX_PIN
            int "LD2410 UART RX GPIO"
            default 5
            range 0 39
            help
                GPIO pin connected to LD2410 TX (ESP32 receives).

        config RS1_LD2410_TX_PIN
            int "LD2410 UART TX GPIO"
            default 4
            range 0 39
            help
                GPIO pin connected to LD2410 RX (ESP32 transmits).

        config RS1_LD2450_RX_PIN
            int "LD2450 UART RX GPIO (Pro only)"
            default 17
            range 0 39
            depends on RS1_VARIANT_PRO
            help
                GPIO pin connected to LD2450 TX (ESP32 receives).

        config RS1_LD2450_TX_PIN
            int "LD2450 UART TX GPIO (Pro only)"
            default 16
            range 0 39
            depends on RS1_VARIANT_PRO
            help
                GPIO pin connected to LD2450 RX (ESP32 transmits).

        config RS1_RADAR_DISCONNECT_TIMEOUT_MS
            int "Radar Disconnect Timeout (ms)"
            default 3000
            range 1000 10000
            help
                Time without radar frames before declaring disconnected.

    endmenu

    menu "Debug Configuration"

        config RS1_DEBUG_RADAR_OUTPUT
            bool "Enable Radar Debug Output"
            default y
            help
                Print parsed radar data to serial console.

        config RS1_DEBUG_HEAP_MONITOR
            bool "Enable Heap Monitoring"
            default y
            help
                Periodically log heap usage statistics.

        config RS1_DEBUG_FRAME_TIMING
            bool "Enable Frame Timing Debug"
            default n
            help
                Log timing information for each radar frame.

    endmenu

endmenu
```

## firmware/sdkconfig.defaults
```kconfig
# RS-1 HardwareOS SDK Configuration Defaults
# ESP32-WROOM-32E Target
# Reference: docs/hardware/HARDWARE_SPEC.md

# Target: ESP32 (not S2/S3/C3)
CONFIG_IDF_TARGET="esp32"

# Flash Configuration (8MB N8 variant)
CONFIG_ESPTOOLPY_FLASHSIZE_8MB=y
CONFIG_ESPTOOLPY_FLASHSIZE="8MB"
CONFIG_PARTITION_TABLE_CUSTOM=y
CONFIG_PARTITION_TABLE_CUSTOM_FILENAME="partitions.csv"

# CPU Frequency
CONFIG_ESP_DEFAULT_CPU_FREQ_MHZ_240=y
CONFIG_ESP_DEFAULT_CPU_FREQ_MHZ=240

# FreeRTOS Configuration
CONFIG_FREERTOS_HZ=1000
CONFIG_FREERTOS_UNICORE=n
CONFIG_FREERTOS_USE_TRACE_FACILITY=y
CONFIG_FREERTOS_GENERATE_RUN_TIME_STATS=y

# Wi-Fi Configuration
CONFIG_ESP_WIFI_STATIC_RX_BUFFER_NUM=16
CONFIG_ESP_WIFI_DYNAMIC_RX_BUFFER_NUM=32
CONFIG_ESP_WIFI_TX_BUFFER_TYPE=1
CONFIG_ESP_WIFI_DYNAMIC_TX_BUFFER_NUM=32

# Logging
CONFIG_LOG_DEFAULT_LEVEL_INFO=y
CONFIG_LOG_DEFAULT_LEVEL=3
CONFIG_LOG_COLORS=y

# UART
CONFIG_ESP_CONSOLE_UART_DEFAULT=y
CONFIG_ESP_CONSOLE_UART_BAUDRATE=115200

# NVS
CONFIG_NVS_ENCRYPTION=n

# Watchdog
CONFIG_ESP_TASK_WDT=y
CONFIG_ESP_TASK_WDT_TIMEOUT_S=10
CONFIG_ESP_TASK_WDT_CHECK_IDLE_TASK_CPU0=y
CONFIG_ESP_TASK_WDT_CHECK_IDLE_TASK_CPU1=y

# Heap
CONFIG_HEAP_CORRUPTION_DETECTION=1
CONFIG_HEAP_TRACING_OFF=y

# mbedTLS (TLS for MQTT/HTTPS)
CONFIG_MBEDTLS_SSL_MAX_CONTENT_LEN=16384
CONFIG_MBEDTLS_ASYMMETRIC_CONTENT_LEN=y
CONFIG_MBEDTLS_SSL_IN_CONTENT_LEN=16384
CONFIG_MBEDTLS_SSL_OUT_CONTENT_LEN=4096

# OTA
CONFIG_BOOTLOADER_APP_ROLLBACK_ENABLE=y
CONFIG_BOOTLOADER_FACTORY_RESET=n

# Power Management (disabled for consistent timing)
CONFIG_PM_ENABLE=n

# RS-1 Specific (defaults to Pro variant)
CONFIG_RS1_VARIANT_PRO=y
CONFIG_RS1_DEBUG_RADAR_OUTPUT=y
CONFIG_RS1_DEBUG_HEAP_MONITOR=y
```
